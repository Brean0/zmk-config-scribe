## config/boards/shields/Kconfig.defconfig
```kconfig
if SHIELD_CALDERA_LEFT

config ZMK_KEYBOARD_NAME
    default "Scribe"

config ZMK_SPLIT_ROLE_CENTRAL
    default y

endif

if SHIELD_SCRIBE_LEFT || SHIELD_SCRIBE_RIGHT

config ZMK_SPLIT
    default y

endif
```

## config/boards/shields/Kconfig.shield
```kconfig
config SHIELD_SCRIBE_LEFT
    def_bool $(shields_list_contains,scribe_left)

config SHIELD_SCRIBE_RIGHT
    def_bool $(shields_list_contains,scribe_right)
```
